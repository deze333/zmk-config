/* source keypos definitions */
#include "keypos_adv360.h"

/* map 360's extra keys */
#define X_LT    &kp EQUAL &kp F1 &kp F2 &kp F3 &kp F4 &kp F5 &kp F11     &kp F12 &kp F6 &kp F7 &kp F8 &kp F9 &kp F10 &kp MINUS \
                &kp TAB
#define X_MT    &none &none
#define X_RT    &kp BSLH

#define X_LM    &kp ESC
#define X_MM    &none &none
#define X_RM    &kp SQT

#define X_LB    &kp LSHFT
#define X_RB    &kp RSHFT

//#define X_LH    &none &kp GRAVE &kp CAPS &kp LEFT &kp RIGHT     &kp UP &kp DOWN U_WH_D U_WH_U &none \
//                &kp LCTRL &kp LALT      &kp LGUI  &kp RCTRL
#define X_LH    &mo SYS &kp GRAVE &kp CAPS &kp LEFT &kp RIGHT     &kp UP &kp DOWN U_WH_D U_WH_U &mo SYS \
                &kp LCTRL &kp LALT      &kp LGUI  &kp RCTRL
#define X_MH    &kp HOME    &kp PG_UP
#define X_RH    &kp END     &kp PG_DN

/* activate bluetooth */
#define CONFIG_WIRELESS 1

/* leds and backlights */
#include <dt-bindings/zmk/rgb.h>
#include <dt-bindings/zmk/backlight.h>

/* source the main keymap */
#include "base.keymap"

/* use urob's layout for Advantage 360 pro */
/ { chosen { zmk,matrix_transform = &urobs_transform; }; };

